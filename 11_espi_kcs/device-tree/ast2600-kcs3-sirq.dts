/dts-v1/;
/plugin/;

#include <dt-bindings/interrupt-controller/irq.h>

/* Example only: SIRQ 11 and polarity must match host chipset/firmware. */
&kcs3 {
	status = "okay";
	aspeed,lpc-io-reg = <0xca2>;
	aspeed,lpc-interrupts = <11 IRQ_TYPE_LEVEL_LOW>;
};

