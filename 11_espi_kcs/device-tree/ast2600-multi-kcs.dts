/dts-v1/;
/plugin/;

/* Example multi-host mapping; confirm non-overlapping addresses in firmware. */
&kcs3 {
	status = "okay";
	aspeed,lpc-io-reg = <0xca2>;
};

&kcs4 {
	status = "okay";
	aspeed,lpc-io-reg = <0xca4>;
};

