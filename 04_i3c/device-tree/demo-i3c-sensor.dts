/dts-v1/;
/plugin/;

/*
 * Linux I3C fragment for the fictional demo target.
 * PID fields: manufacturer 0x0123, part 0x0456, instance 1, extra 0x004.
 */

&i3c0 {
	status = "okay";
	#address-cells = <3>;
	#size-cells = <0>;
	i3c-scl-hz = <12500000>;

	demo_sensor: sensor@0,24604561004 {
		compatible = "demo,i3c-temp-sensor";
		reg = <0x0 0x246 0x04561004>;
		assigned-address = <0x30>;
	};
};

