/dts-v1/;
/plugin/;

/* Replace &spi0 and pin configuration for the target BMC SoC. */
&spi0 {
	status = "okay";
	#address-cells = <1>;
	#size-cells = <0>;

	temperature-sensor@0 {
		compatible = "openai,demo-spi-sensor";
		reg = <0>;
		spi-max-frequency = <1000000>;
	};
};

