## 01_gpio_irq/client-driver/Kconfig
```kconfig
config DEMO_GPIO_IRQ
	tristate "Educational GPIO and IRQ monitor"
	depends on GPIOLIB
	depends on OF || COMPILE_TEST
	help
	  Build an educational platform driver that requests presence, fault,
	  and reset GPIO descriptors, maps input GPIOs to threaded IRQs, and
	  exposes simple diagnostic attributes. This is a study example, not a
	  production board-management policy driver.
```

## 02_i2c_smbus/client-driver/Kconfig
```kconfig
config SENSORS_DEMO_I2C
	tristate "Educational demo I2C temperature sensor"
	depends on I2C
	select REGMAP_I2C
	help
	  Build an educational hwmon client driver for the fictional
	  demo,temp-sensor device. This is a study example, not a driver for
	  production hardware.
```

## 03_i2c_mux/client-driver/Kconfig
```kconfig
config DEMO_I2C_MUX
	tristate "Educational four-channel I2C mux"
	depends on I2C && I2C_MUX
	help
	  Build a study-only driver for the fictional demo,quad-i2c-mux.

	  The device uses a one-byte, one-hot channel selector. This example
	  demonstrates i2c-mux-core integration and parent-locked callbacks; it
	  must not be used for real hardware without a datasheet-based rewrite.
```

## 04_i3c/client-driver/Kconfig
```kconfig
config DEMO_I3C_SENSOR
	tristate "Educational I3C temperature sensor"
	depends on I3C && HWMON
	help
	  Build a study-only Linux 6.18 driver for a fictional I3C sensor.

	  The example demonstrates PID-based matching, private SDR transfers,
	  hwmon registration, IBI allocation/handling, and teardown. It must be
	  adapted to a real target datasheet and target kernel API.
```

## 05_spi/client-driver/Kconfig
```kconfig
config DEMO_SPI_SENSOR
	tristate "Demo SPI board-management sensor"
	depends on SPI && HWMON
	help
	  Educational driver for the fictional openai,demo-spi-sensor device.
	  This is not a binding or driver for production hardware.
```

## 06_hwmon_iio/client-driver/Kconfig
```kconfig
config DEMO_BMC_ADC
	tristate "Demo BMC MMIO ADC"
	depends on IIO
	depends on HAS_IOMEM
	help
	  Educational IIO provider for a fictional four-channel BMC ADC.
	  It is not suitable for production hardware.
```

## 07_pwm_tach_fan/client-driver/Kconfig
```kconfig
config DEMO_PWM_TACH_FAN
	tristate "Demo PWM and tachometer fan"
	depends on PWM && GPIOLIB && HWMON
	help
	  Educational PWM consumer and GPIO tach IRQ hwmon driver.
	  Prefer the in-tree pwm-fan driver when it fits real hardware.
```

## 08_uart_vuart/client-driver/Kconfig
```kconfig
config DEMO_UART_MCU
	tristate "Demo UART management MCU serdev client"
	depends on SERIAL_DEV_BUS
	help
	  Educational newline-framed serdev client for a fictional management MCU.
	  It periodically transmits PING and safely bounds received lines.
```

## 12_usb/client-driver/Kconfig
```kconfig
config DEMO_USB_BULK
	tristate "Educational USB bulk loopback client"
	depends on USB
	help
	  Build a study-only host interface driver for the configfs Loopback
	  gadget using reserved lab VID/PID ffff:ffff. Never enable this identity
	  in a production image.
```

## 13_can/client-driver/Kconfig
```kconfig
config DEMO_MMIO_CAN
	tristate "Educational fictional MMIO CAN controller"
	depends on CAN_DEV && OF && HAS_IOMEM
	help
	  Study-only SocketCAN controller skeleton using a fictional register map.
	  It cannot operate real hardware and must never be selected for a product.
```

## 14_lin/client-driver/Kconfig
```kconfig
config DEMO_LIN_SENSOR
	tristate "Educational UART/serdev LIN temperature sensor"
	depends on SERIAL_DEV_BUS && HWMON && GPIOLIB
	help
	  Study-only LIN master/client using UART break control and a fictional
	  temperature response. This is not a generic LIN subsystem or production
	  protocol driver.
```
